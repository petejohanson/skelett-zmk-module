## boards/arm/novelkeys_skelett40/Kconfig.board
```kconfig
# Copyright (c) 2023 The ZMK Contributors
# SPDX-License-Identifier: Apache-2.0

config BOARD_NOVELKEYS_SKELETT40
    bool "NovelKeys Skelett40"
    depends on SOC_STM32F072XB
```

## boards/arm/novelkeys_skelett40/novelkeys_skelett40_defconfig
```kconfig
# Copyright (c) 2023 The ZMK Contributors
# SPDX-License-Identifier: MIT

CONFIG_BOARD_NOVELKEYS_SKELETT40=y

CONFIG_SOC_SERIES_STM32F0X=y
CONFIG_SOC_STM32F072XB=y
# 48MHz system clock
CONFIG_SYS_CLOCK_HW_CYCLES_PER_SEC=48000000

CONFIG_PINCTRL=y

CONFIG_GPIO=y

CONFIG_ZMK_USB=y
CONFIG_USB_SELF_POWERED=n

CONFIG_CLOCK_CONTROL=y

CONFIG_ZMK_KSCAN_MATRIX_POLLING=y

# General RAM savings
CONFIG_SRAM_VECTOR_TABLE=n

# Studio Settings
CONFIG_ZMK_BEHAVIOR_LOCAL_ID_TYPE_CRC16=y
CONFIG_ZMK_STUDIO_RPC_THREAD_STACK_SIZE=3800
CONFIG_ZMK_STUDIO_RPC_TX_BUF_SIZE=32
CONFIG_ZMK_KEYMAP_LAYER_NAME_MAX_LEN=10
CONFIG_FLASH=y
CONFIG_FLASH_MAP=y
CONFIG_NVS=y

# Bootloader support
CONFIG_RETAINED_MEM=y
CONFIG_RETENTION=y
CONFIG_RETENTION_BOOT_MODE=y
CONFIG_STM32_BOOTLOADER=y

# Zephyr Memory Reduction Settings
CONFIG_ISR_STACK_SIZE=756
CONFIG_MAIN_STACK_SIZE=756
CONFIG_USB_CDC_ACM_RINGBUF_SIZE=256
CONFIG_USB_WORKQUEUE_STACK_SIZE=800

# ZMK Specific Memory Reduction
CONFIG_ZMK_BEHAVIOR_HOLD_TAP_MAX_HELD=3
CONFIG_ZMK_BEHAVIOR_HOLD_TAP_MAX_CAPTURED_EVENTS=10
CONFIG_ZMK_BEHAVIOR_STICKY_KEY_MAX_HELD=3
CONFIG_ZMK_BEHAVIORS_QUEUE_SIZE=8
CONFIG_ZMK_COMBO_MAX_PRESSED_COMBOS=1
CONFIG_ZMK_COMBO_MAX_COMBOS_PER_KEY=1
CONFIG_ZMK_COMBO_MAX_KEYS_PER_COMBO=2
```
